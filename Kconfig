## Kconfig
```kconfig
menu "Button"

	config BUTTON_POLL_TIMEOUT
		int "Poll timeout, ms"
		range 1 1000
		default 10

	config BUTTON_DEAD_TIME
		int "Dead time, ms"
		range 10 1000
		default 50

	config BUTTON_LONG_PRESS_TIMEOUT
		int "Timeout of long press, ms"
		range 100 10000
		default 1000

	config BUTTON_AUTOREPEAT_TIMEOUT
		int "Timeout before autorepeat, ms"
		range 100 10000
		default 500

	config BUTTON_AUTOREPEAT_INTERVAL
		int "Autorepeat interval, ms"
		range 100 10000
		default 250

endmenu
```
